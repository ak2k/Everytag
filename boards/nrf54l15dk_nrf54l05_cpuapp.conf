## boards/nrf54l15dk_nrf54l05_cpuapp.conf
```kconfig
# nRF54L05 board-specific Kconfig overrides
# Merged AFTER prj.conf — only override what's incompatible
#
# Uses Zephyr's nrf54l15dk/nrf54l05/cpuapp variant: same DK PCB,
# L05 SoC limits enforced (500 KB RRAM, 96 KB RAM vs L15's 1500 KB / 256 KB).
# No standalone nRF54L05 DK is sold by Nordic; upstream's
# documented path for L05 development is this variant.

# RRAM storage
CONFIG_SOC_FLASH_NRF_RRAM=y

# RAM power library not available for nrf54L
CONFIG_RAM_POWER_DOWN_LIBRARY=n
CONFIG_RAM_POWER_ADJUST_ON_HEAP_RESIZE=n

# Newlib NANO not available for nrf54L (full newlib works fine)
CONFIG_NEWLIB_LIBC_NANO=n
```

## tests/renode/testcase.yaml
```yaml
tests:
  renode.everytag:
    tags: renode integration
    platform_allow: nrf52dk/nrf52832
    harness: robot
    harness_config:
      robot_test_path: test_everytag.robot
```
