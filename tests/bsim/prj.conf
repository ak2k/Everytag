## CMakeLists.txt
```
# SPDX-License-Identifier: Apache-2.0
cmake_minimum_required(VERSION 3.20.0)
find_package(Zephyr REQUIRED HINTS $ENV{ZEPHYR_BASE})
project(mockingbeacon_bsim_test)

# BabbleSim test framework
add_subdirectory(${ZEPHYR_BASE}/tests/bsim/babblekit babblekit)
target_link_libraries(app PRIVATE babblekit)

zephyr_include_directories(
    ${BSIM_COMPONENTS_PATH}/libUtilv1/src/
    ${BSIM_COMPONENTS_PATH}/libPhyComv1/src/
    ${CMAKE_CURRENT_SOURCE_DIR}/../../src
)

target_sources(app PRIVATE
    src/main.c
    src/advertiser.c
    src/scanner.c
    src/beacon_logic_c_api.cpp
    ../../src/beacon_logic.cpp
)
```

## prj.conf
```kconfig
CONFIG_BT=y
CONFIG_BT_DEVICE_NAME="mockingbeacon-test"

CONFIG_BT_BROADCASTER=y
CONFIG_BT_OBSERVER=y
# Use Zephyr open-source BLE controller (NCS SDC is ARM-only, won't work on x86 bsim)
CONFIG_BT_LL_SW_SPLIT=y

CONFIG_CPP=y
CONFIG_STD_CPP20=y
CONFIG_EXTERNAL_LIBCPP=y

CONFIG_ASSERT=y
CONFIG_LOG=y
CONFIG_ARCH_POSIX_TRAP_ON_FATAL=y
```

## overlay-thread-analyzer.conf
```kconfig
# Thread analyzer overlay for bsim BLE adv + connection cycles.
# Reports stack high-water mark per thread; flag if any thread <20% headroom.
#
# Usage: applied automatically when the bsim-test derivation includes this
# overlay file. See plan §1g step 3 (runtime stack verification).

CONFIG_THREAD_ANALYZER=y
CONFIG_THREAD_ANALYZER_AUTO=y
CONFIG_THREAD_ANALYZER_RUN_UNLOCKED=y
CONFIG_THREAD_ANALYZER_AUTO_INTERVAL=10
CONFIG_THREAD_NAME=y
```

## src/main.c
```c
/*
 * BabbleSim BLE advertisement test for MockingBeacon beacon
 *
 * Two devices:
 * - Device 0 (advertiser): broadcasts AirTag and FMDN advertisements
 *   using the C++ beacon_logic functions, rotates keys
 * - Device 1 (scanner): receives and verifies the exact advertisement
 *   payload bytes match expected values
 */

#include <zephyr/kernel.h>
#include "bs_tracing.h"
#include "bstests.h"
#include "babblekit/testcase.h"

extern void entrypoint_advertiser(void);
extern void entrypoint_scanner(void);
extern enum bst_result_t bst_result;

static void test_end_cb(void)
{
    if (bst_result != Passed) {
        TEST_PRINT("Test has not passed.");
    }
}

static const struct bst_test_instance entrypoints[] = {
    {
        .test_id = "advertiser",
        .test_delete_f = test_end_cb,
        .test_main_f = entrypoint_advertiser,
    },
    {
        .test_id = "scanner",
        .test_delete_f = test_end_cb,
        .test_main_f = entrypoint_scanner,
    },
    BSTEST_END_MARKER,
};

static struct bst_test_list *install(struct bst_test_list *tests)
{
    return bst_add_tests(tests, entrypoints);
}

bst_test_install_t test_installers[] = {install, NULL};

int main(void)
{
    bst_main();
    return 0;
}
```
