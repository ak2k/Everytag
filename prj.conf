## CMakeLists.txt
```
# SPDX-License-Identifier: Apache-2.0

cmake_minimum_required(VERSION 3.20.0)
find_package(Zephyr REQUIRED HINTS $ENV{ZEPHYR_BASE})
project(MockingBeacon)

# C sources (hardware drivers + GATT/BLE glue)
target_sources(app PRIVATE
    src/bq2512x.c
    src/watchdog.c
    src/lis2dw12.c
    src/gatt_glue.c
    src/ble_glue.c
)

# C++ sources
target_sources(app PRIVATE
    src/main.cpp
    src/beacon_logic.cpp
    src/accel_data.cpp
    src/beacon_config.cpp
    src/beacon_state.cpp
    src/zephyr_nvs.cpp
    src/zephyr_hardware.cpp
)

# Relax warnings on existing C code (pre-existing issues, will be replaced)
target_compile_options(app PRIVATE
    $<$<COMPILE_LANGUAGE:C>:
        -Wno-incompatible-pointer-types
    >
)

# C++ compiler flags
# Note: -Wpedantic omitted because Zephyr headers use C99 compound literals
# and named variadic macros which are invalid in strict C++.
# -Wcast-align, -Wconversion, -Wsign-conversion relaxed for Zephyr internal macros.
target_compile_options(app PRIVATE
    $<$<COMPILE_LANGUAGE:CXX>:
        -Wall -Wextra -Werror
        -Wno-missing-field-initializers
        -fno-threadsafe-statics -fno-use-cxa-atexit
    >
)
```

## west.yml
```
manifest:
  remotes:
    - name: nrfconnect
      url-base: https://github.com/nrfconnect
  projects:
    - name: sdk-nrf
      remote: nrfconnect
      path: nrf
      revision: v3.4.0
      import: true
  self:
    path: mockingbeacon
```

## prj.conf
```kconfig
CONFIG_LOG=y
CONFIG_CONSOLE=y
CONFIG_USE_SEGGER_RTT=y
CONFIG_RTT_CONSOLE=y
CONFIG_ZMS_LOG_LEVEL_DBG=y

##CONFIG_LOG_MODE_IMMEDIATE=y

CONFIG_UART_CONSOLE=n
CONFIG_BT=y
CONFIG_BT_SETTINGS=n
CONFIG_BT_PRIVACY=n
CONFIG_BT_GATT_AUTHORIZATION_CUSTOM=y
CONFIG_SPI=n
CONFIG_PWM=n
##CONFIG_I2C=y

CONFIG_SERIAL=n
CONFIG_DYNAMIC_INTERRUPTS=n
CONFIG_IRQ_OFFLOAD=n
##CONFIG_THREAD_STACK_INFO=n
CONFIG_THREAD_CUSTOM_DATA=n
CONFIG_FPU=n
CONFIG_PM=y
CONFIG_PM_DEVICE=y
CONFIG_PM_DEVICE_RUNTIME=y
CONFIG_WATCHDOG=y
CONFIG_ADC=y
CONFIG_GPIO=y
##CONFIG_BOARD_ENABLE_DCDC=y
CONFIG_POWEROFF=y

CONFIG_NEWLIB_LIBC=y
CONFIG_NEWLIB_LIBC_NANO=y

CONFIG_BT_CTLR_TX_PWR_DYNAMIC_CONTROL=y
#CONFIG_CLOCK_CONTROL_NRF_K32SRC_RC=y
#CONFIG_CLOCK_CONTROL_NRF_K32SRC_500PPM=y

CONFIG_BT_PERIPHERAL=y

CONFIG_BT_DEBUG_NONE=y
CONFIG_BT_ASSERT=n
CONFIG_BT_DATA_LEN_UPDATE=n
CONFIG_BT_PHY_UPDATE=n
CONFIG_BT_GATT_CACHING=n
CONFIG_BT_GATT_SERVICE_CHANGED=n
CONFIG_BT_GAP_PERIPHERAL_PREF_PARAMS=y
##CONFIG_BT_HCI_VS_EXT=y
# Disable Bluetooth controller features not needed
CONFIG_BT_CTLR_PRIVACY=n
CONFIG_BT_CTLR_PHY_2M=n

# Reduce Bluetooth buffers

CONFIG_BT_BUF_EVT_DISCARDABLE_COUNT=1
CONFIG_BT_BUF_EVT_DISCARDABLE_SIZE=43
# Zephyr 4.x BUILD_ASSERT (include/zephyr/bluetooth/buf.h:168-172):
#   BT_BUF_EVT_RX_COUNT must be > BT_BUF_ACL_TX_COUNT (=3 below).
CONFIG_BT_BUF_EVT_RX_COUNT=4
##CONFIG_BT_CONN_TX_MAX=2
CONFIG_BT_L2CAP_TX_BUF_COUNT=2
##CONFIG_BT_CTLR_RX_BUFFERS=2
CONFIG_BT_BUF_ACL_TX_COUNT=3
CONFIG_BT_BUF_ACL_TX_SIZE=27
#CONFIG_BT_BUF_ACL_RX_SIZE=27

# Preemptive stack pinning against Zephyr 4.x default flips (plan §1g):
# - IDLE 128 → 256: 4.x init path tighter with stack canaries.
# - BT_HCI_TX 640 → 768: 4.2 bt_hci_cmd_alloc path tighter (Phase 3
#   change pinned now to avoid surprise during the upgrade).
# Others (MAIN/BT_RX/ISR/SYSTEM_WORKQUEUE) already at plan's targets.
CONFIG_BT_RX_STACK_SIZE=1024
CONFIG_BT_HCI_TX_STACK_SIZE_WITH_PROMPT=y
CONFIG_BT_HCI_TX_STACK_SIZE=768
CONFIG_SYSTEM_WORKQUEUE_STACK_SIZE=1024
CONFIG_MAIN_STACK_SIZE=1024
CONFIG_IDLE_STACK_SIZE=256
CONFIG_ISR_STACK_SIZE=1024

CONFIG_FLASH=y
# ZMS settings backend (explicit enable + NVS disable). NCS 3.0+ makes ZMS
# the default for Cortex-M; we pin both to avoid silent default flips.
# CONFIG_SETTINGS_ZMS_MAX_COLLISIONS_BITS is N/A for this firmware — we
# use direct zms_read()/zms_write() with hand-assigned uint16_t IDs
# (src/beacon_nvs_ids.hpp), not the BT_SETTINGS framework.
CONFIG_ZMS=y
CONFIG_NVS=n
CONFIG_ZMS_LOOKUP_CACHE=y
CONFIG_ZMS_LOOKUP_CACHE_FOR_SETTINGS=y
# 128 B RAM on nrf52810 (16 × 8 B/entry). Bump to 64 on nrf54l15 only
# (512 B) via board overlay if settings lookup becomes hot.
CONFIG_ZMS_LOOKUP_CACHE_SIZE=16
CONFIG_REBOOT=y
CONFIG_MPU_ALLOW_FLASH_WRITE=y

# RAM/flash savers for Zephyr 4.x defaults (per migration plan §1d):
# - LOG_BUFFER_SIZE: default rose to 1024 in 4.x; 512 saves ~512 B bss.
# - CBPRINTF_REDUCED_INTEGRAL: drop 64-bit printf paths; ~400-800 B text.
# - BT_HCI_ACL_FLOW_CONTROL: needed only for >1 conn; ~150 B for our 1-conn case.
# - BT_LONG_WQ: defaults n (BT_GATT_CACHING=n above); explicit pin against
#   future Kconfig flips; ~1 KB if it ever auto-enables.
CONFIG_LOG_BUFFER_SIZE=512
CONFIG_CBPRINTF_REDUCED_INTEGRAL=y
CONFIG_BT_HCI_ACL_FLOW_CONTROL=n
CONFIG_BT_LONG_WQ=n
# Plan §1g additional levers (post-stack-pinning audit):
# - BT_CTLR_DUP_FILTER_LEN=0: scanner-only feature; BT_OBSERVER=n here
#   (we're peripheral-only). Saves ~200-400 B bss on nrf52810.
# Note: plan also suggested CONFIG_BT_CONN_TX_MAX=2 but Kconfig minimum
# is 3 in NCS 3.0.2 (range [3, 255] at subsys/bluetooth/host/Kconfig:330).
CONFIG_BT_CTLR_DUP_FILTER_LEN=0

# C++ support
CONFIG_CPP=y
CONFIG_STD_CPP20=y
CONFIG_GLIBCXX_LIBCPP=y
CONFIG_CPP_EXCEPTIONS=n
CONFIG_CPP_RTTI=n
```

## dfu.conf
```kconfig
# MCUmgr/MCUboot OTA overlay — use via EXTRA_CONF_FILE=dfu.conf
# For boards with >= 512KB flash (nRF52832, nRF52833, nRF54L15).
# Composes with prj.conf or prj-lowpower.conf; do NOT use standalone.

# Core MCUmgr + MCUboot
CONFIG_MCUMGR=y
CONFIG_BOOTLOADER_MCUBOOT=y

# SMP BLE transport (auto-registers SMP GATT service)
CONFIG_MCUMGR_TRANSPORT_BT=y
CONFIG_MCUMGR_TRANSPORT_BT_REASSEMBLY=y
CONFIG_MCUMGR_TRANSPORT_BT_CONN_PARAM_CONTROL=y

# Image management (upload, list, confirm, erase)
CONFIG_MCUMGR_GRP_IMG=y
CONFIG_IMG_MANAGER=y
CONFIG_STREAM_FLASH=y
CONFIG_FLASH_MAP=y

# OS management (reset command after upload)
CONFIG_MCUMGR_GRP_OS=y

# Enlarge BT buffers for SMP throughput (overrides small defaults in prj.conf)
CONFIG_BT_L2CAP_TX_MTU=498
CONFIG_BT_BUF_ACL_TX_SIZE=502
CONFIG_BT_BUF_ACL_RX_SIZE=502
CONFIG_BT_L2CAP_TX_BUF_COUNT=4
CONFIG_BT_BUF_ACL_TX_COUNT=4
CONFIG_BT_CTLR_DATA_LENGTH_MAX=251

# MCUmgr needs larger stacks for image hashing/flash writes
CONFIG_SYSTEM_WORKQUEUE_STACK_SIZE=2304
CONFIG_MAIN_STACK_SIZE=2048

# SMP reassembly buffer (5 BLE writes at MTU 498)
CONFIG_MCUMGR_TRANSPORT_NETBUF_SIZE=2475
CONFIG_MCUMGR_GRP_OS_MCUMGR_PARAMS=y
CONFIG_MCUMGR_TRANSPORT_WORKQUEUE_STACK_SIZE=4608

# Flash write permission (needed for image slot writes)
CONFIG_MPU_ALLOW_FLASH_WRITE=y
```

## prj-analyze.conf
```kconfig
CONFIG_LOG=y
CONFIG_CONSOLE=y
CONFIG_USE_SEGGER_RTT=y
CONFIG_RTT_CONSOLE=y
CONFIG_ZMS_LOG_LEVEL_DBG=y

CONFIG_THREAD_ANALYZER=y
CONFIG_THREAD_ANALYZER_USE_PRINTK=y
CONFIG_THREAD_ANALYZER_AUTO=y
CONFIG_THREAD_ANALYZER_AUTO_INTERVAL=10
CONFIG_THREAD_NAME=y
CONFIG_THREAD_MONITOR=y
CONFIG_THREAD_RUNTIME_STATS=y

CONFIG_NEWLIB_LIBC=y
CONFIG_NEWLIB_LIBC_NANO=y
CONFIG_RAM_POWER_DOWN_LIBRARY=y
CONFIG_RAM_POWER_ADJUST_ON_HEAP_RESIZE=y


##CONFIG_LOG_MODE_IMMEDIATE=y

CONFIG_UART_CONSOLE=n
CONFIG_BT=y
CONFIG_BT_SETTINGS=n
CONFIG_BT_PRIVACY=n
CONFIG_BT_GATT_AUTHORIZATION_CUSTOM=y
CONFIG_SPI=n
CONFIG_PWM=n
##CONFIG_I2C=y

CONFIG_SERIAL=n
CONFIG_DYNAMIC_INTERRUPTS=n
CONFIG_IRQ_OFFLOAD=n
##CONFIG_THREAD_STACK_INFO=n
CONFIG_THREAD_CUSTOM_DATA=n
CONFIG_FPU=n
CONFIG_PM=y
CONFIG_PM_DEVICE=y
CONFIG_PM_DEVICE_RUNTIME=y
CONFIG_WATCHDOG=y
CONFIG_ADC=y
CONFIG_GPIO=y
##CONFIG_BOARD_ENABLE_DCDC=y
CONFIG_POWEROFF=y

CONFIG_BT_CTLR_TX_PWR_DYNAMIC_CONTROL=y
#CONFIG_CLOCK_CONTROL_NRF_K32SRC_RC=y
#CONFIG_CLOCK_CONTROL_NRF_K32SRC_500PPM=y

CONFIG_BT_PERIPHERAL=y

CONFIG_BT_DEBUG_NONE=y
CONFIG_BT_ASSERT=n
CONFIG_BT_DATA_LEN_UPDATE=n
CONFIG_BT_PHY_UPDATE=n
CONFIG_BT_GATT_CACHING=n
CONFIG_BT_GATT_SERVICE_CHANGED=n
CONFIG_BT_GAP_PERIPHERAL_PREF_PARAMS=y
CONFIG_BT_SETTINGS_CCC_LAZY_LOADING=n
##CONFIG_BT_HCI_VS_EXT=y
# Disable Bluetooth controller features not needed
CONFIG_BT_CTLR_PRIVACY=n
CONFIG_BT_CTLR_PHY_2M=n

# Reduce Bluetooth buffers

CONFIG_BT_BUF_EVT_DISCARDABLE_COUNT=1
CONFIG_BT_BUF_EVT_DISCARDABLE_SIZE=43
CONFIG_BT_BUF_EVT_RX_COUNT=2
##CONFIG_BT_CONN_TX_MAX=2
CONFIG_BT_L2CAP_TX_BUF_COUNT=2
##CONFIG_BT_CTLR_RX_BUFFERS=2
CONFIG_BT_BUF_ACL_TX_COUNT=3
CONFIG_BT_BUF_ACL_TX_SIZE=27
#CONFIG_BT_BUF_ACL_RX_SIZE=27

CONFIG_BT_RX_STACK_SIZE=1024
CONFIG_BT_HCI_TX_STACK_SIZE_WITH_PROMPT=y
CONFIG_BT_HCI_TX_STACK_SIZE=640
CONFIG_SYSTEM_WORKQUEUE_STACK_SIZE=1024
CONFIG_MAIN_STACK_SIZE=1024
CONFIG_IDLE_STACK_SIZE=128
CONFIG_ISR_STACK_SIZE=1024

CONFIG_FLASH=y
CONFIG_ZMS=y
CONFIG_REBOOT=y
CONFIG_MPU_ALLOW_FLASH_WRITE=y
CONFIG_MCUMGR=n
CONFIG_BOOTLOADER_MCUBOOT=n

# C++ support
CONFIG_CPP=y
CONFIG_STD_CPP20=y
CONFIG_GLIBCXX_LIBCPP=y
CONFIG_CPP_EXCEPTIONS=n
CONFIG_CPP_RTTI=n
```

## prj-lowpower-nrf51.conf
```kconfig
CONFIG_LOG=n
CONFIG_CONSOLE=n
CONFIG_USE_SEGGER_RTT=n
CONFIG_RTT_CONSOLE=n
CONFIG_ZMS_LOG_LEVEL_DBG=n

CONFIG_LOG_MODE_IMMEDIATE=y

CONFIG_UART_CONSOLE=n
CONFIG_BT=y
CONFIG_BT_SETTINGS=n
CONFIG_BT_PRIVACY=n
CONFIG_SPI=n
CONFIG_PWM=n
CONFIG_I2C=n
CONFIG_SERIAL=n
CONFIG_DYNAMIC_INTERRUPTS=n
CONFIG_IRQ_OFFLOAD=n
CONFIG_THREAD_STACK_INFO=n
CONFIG_THREAD_CUSTOM_DATA=n
CONFIG_FPU=n
CONFIG_PM=y
CONFIG_PM_DEVICE=y
CONFIG_WATCHDOG=y
CONFIG_ADC=y
CONFIG_GPIO=y
#CONFIG_BOARD_ENABLE_DCDC=y

CONFIG_BT_CTLR_TX_PWR_DYNAMIC_CONTROL=y
CONFIG_CLOCK_CONTROL_NRF_K32SRC_RC=y
CONFIG_CLOCK_CONTROL_NRF_K32SRC_500PPM=y

CONFIG_BT_PERIPHERAL=y

CONFIG_BT_DEBUG_NONE=y
CONFIG_BT_ASSERT=n
CONFIG_BT_DATA_LEN_UPDATE=n
CONFIG_BT_PHY_UPDATE=n
CONFIG_BT_GATT_CACHING=n
CONFIG_BT_GATT_SERVICE_CHANGED=n
CONFIG_BT_GAP_PERIPHERAL_PREF_PARAMS=y
CONFIG_BT_SETTINGS_CCC_LAZY_LOADING=n
CONFIG_BT_HCI_VS_EXT=y
# Disable Bluetooth controller features not needed
CONFIG_BT_CTLR_PRIVACY=n
CONFIG_BT_CTLR_PHY_2M=n

# Reduce Bluetooth buffers

CONFIG_BT_BUF_EVT_DISCARDABLE_COUNT=1
CONFIG_BT_BUF_EVT_DISCARDABLE_SIZE=43
CONFIG_BT_BUF_EVT_RX_COUNT=2
CONFIG_BT_CONN_TX_MAX=2
CONFIG_BT_L2CAP_TX_BUF_COUNT=2
CONFIG_BT_CTLR_RX_BUFFERS=2
CONFIG_BT_BUF_ACL_TX_COUNT=3
CONFIG_BT_BUF_ACL_TX_SIZE=27
#CONFIG_BT_BUF_ACL_RX_SIZE=27

CONFIG_BT_RX_STACK_SIZE=1024
CONFIG_BT_HCI_TX_STACK_SIZE_WITH_PROMPT=y
CONFIG_BT_HCI_TX_STACK_SIZE=640
CONFIG_SYSTEM_WORKQUEUE_STACK_SIZE=1024
CONFIG_MAIN_STACK_SIZE=1024
CONFIG_IDLE_STACK_SIZE=128
CONFIG_ISR_STACK_SIZE=1024

CONFIG_FLASH=y
CONFIG_ZMS=y
CONFIG_REBOOT=y
CONFIG_MPU_ALLOW_FLASH_WRITE=y
```

## prj-lowpower.conf
```kconfig
CONFIG_LOG=n
CONFIG_CONSOLE=n
CONFIG_USE_SEGGER_RTT=n
CONFIG_RTT_CONSOLE=n
CONFIG_ZMS_LOG_LEVEL_DBG=n

##CONFIG_LOG_MODE_IMMEDIATE=y

CONFIG_UART_CONSOLE=n
CONFIG_BT=y
CONFIG_BT_SETTINGS=n
CONFIG_BT_PRIVACY=n
CONFIG_BT_GATT_AUTHORIZATION_CUSTOM=y
CONFIG_SPI=n
CONFIG_PWM=n
CONFIG_SERIAL=n
CONFIG_DYNAMIC_INTERRUPTS=n
CONFIG_IRQ_OFFLOAD=n
##CONFIG_THREAD_STACK_INFO=n
CONFIG_THREAD_CUSTOM_DATA=n
CONFIG_FPU=n
CONFIG_PM=y
CONFIG_PM_DEVICE=y
CONFIG_PM_DEVICE_RUNTIME=y
CONFIG_WATCHDOG=y
CONFIG_ADC=y
CONFIG_POWEROFF=y

CONFIG_NEWLIB_LIBC=y
CONFIG_NEWLIB_LIBC_NANO=y
CONFIG_RAM_POWER_DOWN_LIBRARY=y
CONFIG_RAM_POWER_ADJUST_ON_HEAP_RESIZE=y

CONFIG_BT_CTLR_TX_PWR_DYNAMIC_CONTROL=y

# Moved to board's <DTS/_defconfig
##CONFIG_CLOCK_CONTROL_NRF_K32SRC_RC=y
##CONFIG_CLOCK_CONTROL_NRF_K32SRC_500PPM=y
##CONFIG_I2C=n
##CONFIG_BOARD_ENABLE_DCDC=y

CONFIG_BT_PERIPHERAL=y

CONFIG_BT_DEBUG_NONE=y
CONFIG_BT_ASSERT=n
CONFIG_BT_DATA_LEN_UPDATE=n
CONFIG_BT_PHY_UPDATE=n
CONFIG_BT_GATT_CACHING=n
CONFIG_BT_GATT_SERVICE_CHANGED=n
CONFIG_BT_GAP_PERIPHERAL_PREF_PARAMS=y
CONFIG_BT_SETTINGS_CCC_LAZY_LOADING=n
##CONFIG_BT_HCI_VS_EXT=y
# Disable Bluetooth controller features not needed
CONFIG_BT_CTLR_PRIVACY=n
CONFIG_BT_CTLR_PHY_2M=n

# Reduce Bluetooth buffers

CONFIG_BT_BUF_EVT_DISCARDABLE_COUNT=1
CONFIG_BT_BUF_EVT_DISCARDABLE_SIZE=43
CONFIG_BT_BUF_EVT_RX_COUNT=2
##CONFIG_BT_CONN_TX_MAX=2
CONFIG_BT_L2CAP_TX_BUF_COUNT=2
##CONFIG_BT_CTLR_RX_BUFFERS=2
CONFIG_BT_BUF_ACL_TX_COUNT=3
CONFIG_BT_BUF_ACL_TX_SIZE=27
#CONFIG_BT_BUF_ACL_RX_SIZE=27

CONFIG_BT_RX_STACK_SIZE=1024
CONFIG_BT_HCI_TX_STACK_SIZE_WITH_PROMPT=y
CONFIG_BT_HCI_TX_STACK_SIZE=640
CONFIG_SYSTEM_WORKQUEUE_STACK_SIZE=1024
CONFIG_MAIN_STACK_SIZE=1024
CONFIG_IDLE_STACK_SIZE=128
CONFIG_ISR_STACK_SIZE=1024

CONFIG_FLASH=y
CONFIG_ZMS=y
CONFIG_REBOOT=y
CONFIG_MPU_ALLOW_FLASH_WRITE=y

# C++ support
CONFIG_CPP=y
CONFIG_STD_CPP20=y
CONFIG_GLIBCXX_LIBCPP=y
CONFIG_CPP_EXCEPTIONS=n
CONFIG_CPP_RTTI=n
```

## prj-nosmpsvr.conf
```kconfig
# Enable MCUmgr and dependencies.
CONFIG_LOG=y
CONFIG_CONSOLE=y
CONFIG_USE_SEGGER_RTT=y
CONFIG_RTT_CONSOLE=y
CONFIG_ZMS_LOG_LEVEL_DBG=y

CONFIG_UART_CONSOLE=n

CONFIG_NET_BUF=n
CONFIG_ZCBOR=n
CONFIG_CRC=y
CONFIG_MCUMGR=n
CONFIG_STREAM_FLASH=n
CONFIG_FLASH_MAP=y

# Some command handlers require a large stack.
CONFIG_SYSTEM_WORKQUEUE_STACK_SIZE=2304
CONFIG_MAIN_STACK_SIZE=2176

# Ensure an MCUboot-compatible binary is generated.
CONFIG_BOOTLOADER_MCUBOOT=n

# Enable flash operations.
CONFIG_FLASH=y

# Required by the `taskstat` command.
CONFIG_THREAD_MONITOR=n

# Support for taskstat command
CONFIG_MCUMGR_GRP_OS_TASKSTAT=n

# Enable statistics and statistic names.
CONFIG_STATS=n
CONFIG_STATS_NAMES=n

# Enable most core commands.
CONFIG_FLASH=y
CONFIG_IMG_MANAGER=n
CONFIG_MCUMGR_GRP_IMG=n
CONFIG_MCUMGR_GRP_OS=n
CONFIG_MCUMGR_GRP_STAT=n

# Enable logging
CONFIG_LOG=y
CONFIG_MCUBOOT_UTIL_LOG_LEVEL_WRN=n

# Disable debug logging
CONFIG_LOG_MAX_LEVEL=3

CONFIG_BT=y
CONFIG_BT_PERIPHERAL=y
CONFIG_BT_GATT_AUTHORIZATION_CUSTOM=y

# Allow for large Bluetooth data packets.
CONFIG_BT_L2CAP_TX_MTU=498
CONFIG_BT_BUF_ACL_RX_SIZE=502
CONFIG_BT_BUF_ACL_TX_SIZE=502
CONFIG_BT_CTLR_DATA_LENGTH_MAX=251

# Enable the Bluetooth mcumgr transport (unauthenticated).
CONFIG_MCUMGR_TRANSPORT_BT=y
CONFIG_MCUMGR_TRANSPORT_BT_CONN_PARAM_CONTROL=y

# Enable the Shell mcumgr transport.
CONFIG_BASE64=y
CONFIG_CRC=y
CONFIG_SHELL=n
CONFIG_SHELL_BACKEND_SERIAL=n
CONFIG_MCUMGR_TRANSPORT_SHELL=y

# Enable the mcumgr Packet Reassembly feature over Bluetooth and its configuration dependencies.
# MCUmgr buffer size is optimized to fit one SMP packet divided into five Bluetooth Write Commands,
# transmitted with the maximum possible MTU value: 498 bytes.
CONFIG_MCUMGR_TRANSPORT_BT_REASSEMBLY=y
CONFIG_MCUMGR_TRANSPORT_NETBUF_SIZE=2475
CONFIG_MCUMGR_GRP_OS_MCUMGR_PARAMS=y
CONFIG_MCUMGR_TRANSPORT_WORKQUEUE_STACK_SIZE=4608

# Enable the LittleFS file system.
CONFIG_FILE_SYSTEM=n
CONFIG_FILE_SYSTEM_LITTLEFS=n

# Enable file system commands
CONFIG_MCUMGR_GRP_FS=y

# Enable the storage erase command.
CONFIG_MCUMGR_GRP_ZBASIC=y
CONFIG_MCUMGR_GRP_ZBASIC_STORAGE_ERASE=n

# Disable Bluetooth ping support
CONFIG_BT_CTLR_LE_PING=n

# Disable shell commands that are not needed
CONFIG_CLOCK_CONTROL_NRF_SHELL=n
CONFIG_DEVICE_SHELL=n
CONFIG_DEVMEM_SHELL=n
CONFIG_FLASH_SHELL=n
CONFIG_BT_CTLR_TX_PWR_DYNAMIC_CONTROL=y
CONFIG_PM=y
CONFIG_PM_DEVICE=y
CONFIG_PM_DEVICE_RUNTIME=y
CONFIG_WATCHDOG=y
CONFIG_ADC=y
CONFIG_GPIO=y
CONFIG_POWEROFF=y
CONFIG_ZMS=y
CONFIG_REBOOT=y
CONFIG_MPU_ALLOW_FLASH_WRITE=y

CONFIG_SPI=n
CONFIG_PWM=n
CONFIG_SERIAL=n
CONFIG_DYNAMIC_INTERRUPTS=n
CONFIG_IRQ_OFFLOAD=n
##CONFIG_THREAD_STACK_INFO=n
CONFIG_THREAD_CUSTOM_DATA=n
CONFIG_FPU=n

# C++ support
CONFIG_CPP=y
CONFIG_STD_CPP20=y
CONFIG_GLIBCXX_LIBCPP=y
CONFIG_CPP_EXCEPTIONS=n
CONFIG_CPP_RTTI=n
```

## prj-smpsvr-lowpower.conf
```kconfig
# Enable MCUmgr and dependencies.
CONFIG_LOG=n
CONFIG_CONSOLE=n
CONFIG_USE_SEGGER_RTT=n
CONFIG_RTT_CONSOLE=n
CONFIG_ZMS_LOG_LEVEL_DBG=n

CONFIG_UART_CONSOLE=n

CONFIG_NET_BUF=y
CONFIG_ZCBOR=y
CONFIG_CRC=y
CONFIG_MCUMGR=y
CONFIG_STREAM_FLASH=y
CONFIG_FLASH_MAP=y

CONFIG_NEWLIB_LIBC=y
CONFIG_NEWLIB_LIBC_NANO=y
CONFIG_RAM_POWER_DOWN_LIBRARY=y
CONFIG_RAM_POWER_ADJUST_ON_HEAP_RESIZE=y

# Some command handlers require a large stack.
CONFIG_SYSTEM_WORKQUEUE_STACK_SIZE=2304
CONFIG_MAIN_STACK_SIZE=2176

# Ensure an MCUboot-compatible binary is generated.
CONFIG_BOOTLOADER_MCUBOOT=y

# Enable flash operations.
CONFIG_FLASH=y

# Required by the `taskstat` command.
CONFIG_THREAD_MONITOR=y

# Support for taskstat command
CONFIG_MCUMGR_GRP_OS_TASKSTAT=y

# Enable statistics and statistic names.
CONFIG_STATS=y
CONFIG_STATS_NAMES=y

# Enable most core commands.
CONFIG_FLASH=y
CONFIG_IMG_MANAGER=y
CONFIG_MCUMGR_GRP_IMG=y
CONFIG_MCUMGR_GRP_OS=y
CONFIG_MCUMGR_GRP_STAT=y

# Enable logging
CONFIG_LOG=y
CONFIG_MCUBOOT_UTIL_LOG_LEVEL_WRN=y

# Disable debug logging
CONFIG_LOG_MAX_LEVEL=3

CONFIG_BT=y
CONFIG_BT_PERIPHERAL=y
CONFIG_BT_GATT_AUTHORIZATION_CUSTOM=y

# Allow for large Bluetooth data packets.
CONFIG_BT_L2CAP_TX_MTU=498
CONFIG_BT_BUF_ACL_RX_SIZE=502
CONFIG_BT_BUF_ACL_TX_SIZE=502
CONFIG_BT_CTLR_DATA_LENGTH_MAX=251

# Enable the Bluetooth mcumgr transport (unauthenticated).
CONFIG_MCUMGR_TRANSPORT_BT=y
CONFIG_MCUMGR_TRANSPORT_BT_CONN_PARAM_CONTROL=y

# Enable the Shell mcumgr transport.
CONFIG_BASE64=y
CONFIG_CRC=y
CONFIG_SHELL=n
CONFIG_SHELL_BACKEND_SERIAL=n
CONFIG_MCUMGR_TRANSPORT_SHELL=y

# Enable the mcumgr Packet Reassembly feature over Bluetooth and its configuration dependencies.
# MCUmgr buffer size is optimized to fit one SMP packet divided into five Bluetooth Write Commands,
# transmitted with the maximum possible MTU value: 498 bytes.
CONFIG_MCUMGR_TRANSPORT_BT_REASSEMBLY=y
CONFIG_MCUMGR_TRANSPORT_NETBUF_SIZE=2475
CONFIG_MCUMGR_GRP_OS_MCUMGR_PARAMS=y
CONFIG_MCUMGR_TRANSPORT_WORKQUEUE_STACK_SIZE=4608

# Enable the LittleFS file system.
CONFIG_FILE_SYSTEM=n
CONFIG_FILE_SYSTEM_LITTLEFS=n

# Enable file system commands
CONFIG_MCUMGR_GRP_FS=y

# Enable the storage erase command.
CONFIG_MCUMGR_GRP_ZBASIC=y
CONFIG_MCUMGR_GRP_ZBASIC_STORAGE_ERASE=n

# Disable Bluetooth ping support
CONFIG_BT_CTLR_LE_PING=n

# Disable shell commands that are not needed
CONFIG_CLOCK_CONTROL_NRF_SHELL=n
CONFIG_DEVICE_SHELL=n
CONFIG_DEVMEM_SHELL=n
CONFIG_FLASH_SHELL=n
CONFIG_BT_CTLR_TX_PWR_DYNAMIC_CONTROL=y
CONFIG_PM=y
CONFIG_PM_DEVICE=y
CONFIG_PM_DEVICE_RUNTIME=y
CONFIG_WATCHDOG=y
CONFIG_ADC=y
CONFIG_GPIO=y
CONFIG_POWEROFF=y
CONFIG_ZMS=y
CONFIG_REBOOT=y
CONFIG_MPU_ALLOW_FLASH_WRITE=y


CONFIG_SPI=n
CONFIG_PWM=n
CONFIG_SERIAL=n
CONFIG_DYNAMIC_INTERRUPTS=n
CONFIG_IRQ_OFFLOAD=n
##CONFIG_THREAD_STACK_INFO=n
CONFIG_THREAD_CUSTOM_DATA=n
CONFIG_FPU=n

# C++ support
CONFIG_CPP=y
CONFIG_STD_CPP20=y
CONFIG_GLIBCXX_LIBCPP=y
CONFIG_CPP_EXCEPTIONS=n
CONFIG_CPP_RTTI=n
```

## src/main.cpp
```c
// main.cpp -- New entry point for MockingBeacon firmware (C++ state machine)

#include "accel_data.hpp"
#include "beacon_config.hpp"
#include "beacon_state.hpp"
#include "zephyr_hardware.hpp"
#include "zephyr_nvs.hpp"

#include "myboards.h"

extern "C" {
extern int accelThreshold; // defined in zephyr_hardware.cpp, used by lis2dw12.c
#include "gatt_glue.h"
#include "watchdog.h"
#ifdef USE_BUTTON
#include <zephyr/drivers/gpio.h>
#endif
#ifdef HAS_LED1_SWITCH
#include <zephyr/drivers/gpio.h>
#endif
#include <zephyr/kernel.h>
#include <zephyr/sys/printk.h>
}

// GPIO specs needed for button and LED1 gate initialization
#ifdef USE_BUTTON
static const struct gpio_dt_spec sw0 = GPIO_DT_SPEC_GET(DT_ALIAS(sw0), gpios);
#endif
#ifdef HAS_LED1_SWITCH
#define LED1_NODE DT_NODELABEL(led1)
static const struct gpio_dt_spec gate_spec = GPIO_DT_SPEC_GET(LED1_NODE, gpios);
#endif

int main(void) {
    // All objects are static to avoid stack overflow (main stack is 1024 bytes)
    static beacon::ZephyrNvsStorage nvs;
    static beacon::SettingsManager settings(nvs);
    static beacon::MovementTracker accel;
    static beacon::ZephyrHardware hw(settings);
    static beacon::StateMachine sm(hw, settings, accel);

    my_wdt_init();
    printk("Beacon starting (C++)\n");

#ifdef USE_BUTTON
    // Configure button pin
    int err = gpio_pin_configure_dt(&sw0, GPIO_INPUT);
    if (err < 0) {
        printk("Could not configure sw0 GPIO (%d)\n", err);
        return 0;
    }
#endif

#ifdef HAS_LED1_SWITCH
    // Turn off mosfet
    gpio_pin_configure_dt(&gate_spec, GPIO_OUTPUT_ACTIVE);
#endif

    // Initialize NVS and load settings (continue with defaults on failure)
    if (nvs.init() != 0) {
        printk("Warning: NVS init failed, using defaults\n");
    }
    if (settings.load() != 0) {
        printk("Warning: settings load failed, using defaults\n");
    }

    // Sync the C global used by lis2dw12.c (NVS may have loaded a different threshold)
    accelThreshold = static_cast<int>(settings.config().accel_threshold);

    // Set up GATT glue pointers
    glue_init(&settings, &sm);

    // Run the state machine
    sm.initialize();

    while (true) {
        // Sync GATT connection state into state machine before each tick
        glue_sync_gatt_state(&sm);
        sm.tick();
    }

    return 0;
}
```

## src/accel_data.cpp
```c
// accel_data.cpp — Movement tracking with circular buffer
#include "accel_data.hpp"

#include <cstdlib>
#include <cstring>

namespace beacon {

void MovementTracker::record_reading(const int16_t samples[][3], int count, int threshold,
                                     uint32_t uptime_sec) {
    // Determine starting index for comparison.
    // If last_sample_ is the sentinel {-1,-1,-1}, we have no previous reading
    // so we skip the first comparison (start from index 2 instead of 1).
    int first = 1;
    if (last_sample_[0] == -1 && last_sample_[1] == -1 && last_sample_[2] == -1) {
        first = 2;
    }

    // The original C code stores the previous last sample in samples[0]
    // and reads new data into samples[1..32]. We replicate that logic:
    // compare using last_sample_ as the "previous" for samples[1],
    // then consecutive pairs within samples[].

    int movements = 0;
    for (int i = first; i < count; i++) {
        const int16_t* prev = (i == 1) ? last_sample_ : samples[i - 1]; // NOLINT
        if (std::abs(prev[0] - samples[i][0]) > threshold ||
            std::abs(prev[1] - samples[i][1]) > threshold ||
            std::abs(prev[2] - samples[i][2]) > threshold) {
            movements++;
        }
    }

    // Shift 20-second array right by 1
    std::memmove(moves20_ + 1, moves20_, static_cast<size_t>(kMoves20Size - 1));
    moves20_[0] = (movements > 1) ? 1 : 0;

    // Check if we need to shift the 300-second (5-minute) array
    if (uptime_sec > last_shift_time_ + 300) {
        std::memmove(moves300_ + 1, moves300_, static_cast<size_t>(kMoves300Size - 1));
        last_shift_time_ = uptime_sec;
    }

    // Update first two elements of moves300_ from moves20_
    moves300_[0] = 0;
    moves300_[1] = 0;
    for (int i = 0; i < 15; i++) {
        if (moves20_[i] != 0) {
            moves300_[0] = 1;
            break;
        }
    }
    for (int i = 15; i < kMoves20Size; i++) {
        if (moves20_[i] != 0) {
            moves300_[1] = 1;
            break;
        }
    }

    // Save last sample for next call
    if (count > 0) {
        last_sample_[0] = samples[count - 1][0];
        last_sample_[1] = samples[count - 1][1];
        last_sample_[2] = samples[count - 1][2];
    }
}

bool MovementTracker::has_movement(int start_min, int end_min) const {
    int start = start_min / 5;
    int end = (end_min + 4) / 5;

    if (start < 0 || start >= kMoves300Size) {
        start = 0;
    }
    if (end < 0 || end > kMoves300Size) {
        end = kMoves300Size;
    }

    for (int i = start; i < end; i++) {
        if (moves300_[i] > 0) {
            return true;
        }
    }
    return false;
}

uint8_t MovementTracker::compute_accel_byte() const {
    uint8_t res = 0;

    // bit 0: movements in 0..10 minutes
    if (has_movement(0, 10)) {
        res |= 0x01;
    }
    // bit 1: 10..30 minutes
    if (has_movement(10, 30)) {
        res |= 0x02;
    }
    // bit 2: 30..60 minutes
    if (has_movement(30, 60)) {
        res |= 0x04;
    }
    // bit 3: 1..3 hours
    if (has_movement(60, 180)) {
        res |= 0x08;
    }
    // bit 4: 3..6 hours
    if (has_movement(180, 360)) {
        res |= 0x10;
    }
    // bit 5: 6..12 hours
    if (has_movement(360, 720)) {
        res |= 0x20;
    }
    // bit 6: 12..24 hours
    if (has_movement(720, 1440)) {
        res |= 0x40;
    }

    return res;
}

} // namespace beacon
```

## src/accel_data.hpp
```c
// accel_data.hpp — Movement tracking with circular buffer
#ifndef ACCEL_DATA_HPP
#define ACCEL_DATA_HPP

#include <cstdint>

namespace beacon {

class MovementTracker {
  public:
    /// Process a batch of accelerometer FIFO samples.
    /// @param samples   Nx3 array of int16_t (X,Y,Z per sample)
    /// @param count     number of samples (typically 33)
    /// @param threshold per-axis movement threshold
    /// @param uptime_sec current uptime in seconds
    void record_reading(const int16_t samples[][3], int count, int threshold, uint32_t uptime_sec);

    /// Check whether movement was detected in a time window.
    /// @param start_min  start of window in minutes from now
    /// @param end_min    end of window in minutes from now
    /// @return true if any 5-minute slot in the range recorded movement
    bool has_movement(int start_min, int end_min) const;

    /// Compute a 7-bit movement summary byte.
    /// Each bit covers a progressively longer time window.
    uint8_t compute_accel_byte() const;

    /// Get the most recent accelerometer temperature reading.
    int16_t temperature() const { return temperature_; }

    /// Set the accelerometer temperature (read separately via I2C).
    void set_temperature(int16_t t) { temperature_ = t; }

    // Expose internal state for testing
    const uint8_t* moves20() const { return moves20_; }
    const uint8_t* moves300() const { return moves300_; }

    static constexpr int kMoves20Size = 30;
    static constexpr int kMoves300Size = 288;

  private:
    uint8_t moves20_[kMoves20Size] = {};
    uint8_t moves300_[kMoves300Size] = {};
    int16_t last_sample_[3] = {-1, -1, -1};
    int16_t temperature_ = 0;
    uint32_t last_shift_time_ = 0;
};

} // namespace beacon

#endif // ACCEL_DATA_HPP
```

## src/beacon_config.cpp
```c
// beacon_config.cpp — Settings, NVS persistence, GATT validation
#include "beacon_config.hpp"

namespace beacon {

// ---- StatusFlags ----

uint32_t StatusFlags::pack() const {
    return static_cast<uint32_t>(airtag_base) | (static_cast<uint32_t>(fmdn_base) << 8) |
           (static_cast<uint32_t>(airtag_mode) << 16) | (static_cast<uint32_t>(fmdn_mode) << 20);
}

StatusFlags StatusFlags::unpack(uint32_t raw) {
    StatusFlags f;
    f.airtag_base = static_cast<uint8_t>(raw & 0xFF);
    f.fmdn_base = static_cast<uint8_t>((raw >> 8) & 0xFF);
    f.airtag_mode = static_cast<StatusMode>((raw >> 16) & 0xF);
    f.fmdn_mode = static_cast<StatusMode>((raw >> 20) & 0xF);
    return f;
}

// ---- SettingsManager ----

SettingsManager::SettingsManager(INvsStorage& nvs) : nvs_(nvs) {}

void SettingsManager::read_bool(uint16_t id, bool& dest) {
    int tmp = 0;
    if (nvs_.read(id, &tmp, sizeof(tmp)) > 0) {
        dest = (tmp != 0);
    }
}

int SettingsManager::load() {
    // Reset to defaults first
    config_ = BeaconConfig{};

    // Read boolean settings from NVS (stored as 4-byte int)
    read_bool(ID_fmdn_NVS, config_.flag_fmdn);
    read_bool(ID_airtag_NVS, config_.flag_airtag);
    read_bool(ID_turnedOn_NVS, config_.turned_on);

    // Read narrowed scalar fields with validation.
    // NVS wire format is always 4-byte int; invalid values are rejected (keep default).
    {
        int tmp = 0;
        if (nvs_.read(ID_period_NVS, &tmp, sizeof(tmp)) > 0) {
            if (tmp == 1 || tmp == 2 || tmp == 4 || tmp == 8) {
                config_.mult_period = static_cast<uint8_t>(tmp);
            }
            // else: keep default (mult_period=0 causes busy-loop, must reject)
        }
    }
    {
        int tmp = 0;
        if (nvs_.read(ID_power_NVS, &tmp, sizeof(tmp)) > 0) {
            if (tmp >= 0 && tmp <= 2) {
                config_.tx_power = static_cast<uint8_t>(tmp);
            }
        }
    }
    {
        int tmp = 0;
        if (nvs_.read(ID_changeInterval_NVS, &tmp, sizeof(tmp)) > 0) {
            if (tmp >= 30 && tmp <= 7200) {
                config_.change_interval =
                    static_cast<uint16_t>(tmp - (tmp % 8)); // Align to multiple of 8
            }
        }
    }
    {
        int tmp = 0;
        if (nvs_.read(ID_status_NVS, &tmp, sizeof(tmp)) > 0) {
            config_.status_flags = static_cast<uint32_t>(tmp);
        }
    }
    {
        int tmp = 0;
        if (nvs_.read(ID_accel_NVS, &tmp, sizeof(tmp)) > 0) {
            if (tmp >= 0 && tmp <= 16383) {
                config_.accel_threshold = static_cast<uint16_t>(tmp);
            }
        }
    }

    // Time offset is int64_t
    {
        int64_t tmp = 0;
        if (nvs_.read(ID_timeOffset_NVS, &tmp, sizeof(tmp)) > 0) {
            config_.time_offset = tmp;
        }
    }

    // Settings MAC
    nvs_.read(ID_settingsMAC_NVS, config_.settings_mac.data(), config_.settings_mac.size());

    // Auth code
    nvs_.read(ID_auth_NVS, config_.auth_code.data(), config_.auth_code.size());

    // Load airtag keys from NVS
    if (nvs_.read(ID_key_NVS, config_.keys.data(), sizeof(config_.keys)) > 0) {
        // Count non-zero keys (BUG FIX: original compared against sizeof
        // which is 1120 bytes, not 40 elements)
        int count = 0;
        for (int i = 0; i < kMaxKeysInMemory; i++) {
            bool all_zero = true;
            for (int j = 0; j < kKeySize; j++) {
                if (config_.keys[static_cast<size_t>(i)][static_cast<size_t>(j)] != 0) {
                    all_zero = false;
                    break;
                }
            }
            if (all_zero) {
                break;
            }
            count++;
        }
        config_.num_keys = static_cast<uint8_t>(count);
    } else {
        config_.num_keys = 0;
    }

    // Load FMDN key (fall back to empty default)
    if (nvs_.read(ID_fmdnKey_NVS, config_.fmdn_key.data(), config_.fmdn_key.size()) <= 0) {
        config_.fmdn_key = {};
    }

    return 0;
}

// NVS wire format: all scalar fields stored as 4-byte int for backward compatibility.
// Narrowed C++ types are widened to int before writing.
int SettingsManager::save_field(uint16_t field_id) {
    switch (field_id) {
    case ID_fmdn_NVS: {
        int v = config_.flag_fmdn ? 1 : 0;
        return nvs_.write(field_id, &v, sizeof(v));
    }
    case ID_airtag_NVS: {
        int v = config_.flag_airtag ? 1 : 0;
        return nvs_.write(field_id, &v, sizeof(v));
    }
    case ID_period_NVS: {
        int v = static_cast<int>(config_.mult_period);
        return nvs_.write(field_id, &v, sizeof(v));
    }
    case ID_changeInterval_NVS: {
        int v = static_cast<int>(config_.change_interval);
        return nvs_.write(field_id, &v, sizeof(v));
    }
    case ID_key_NVS:
        return nvs_.write(field_id, config_.keys.data(), sizeof(config_.keys));
    case ID_auth_NVS:
        return nvs_.write(field_id, config_.auth_code.data(), config_.auth_code.size());
    case ID_power_NVS: {
        int v = static_cast<int>(config_.tx_power);
        return nvs_.write(field_id, &v, sizeof(v));
    }
    case ID_fmdnKey_NVS:
        return nvs_.write(field_id, config_.fmdn_key.data(), config_.fmdn_key.size());
    case ID_timeOffset_NVS:
        return nvs_.write(field_id, &config_.time_offset, sizeof(config_.time_offset));
    case ID_settingsMAC_NVS:
        return nvs_.write(field_id, config_.settings_mac.data(), config_.settings_mac.size());
    case ID_status_NVS: {
        int v = static_cast<int>(config_.status_flags);
        return nvs_.write(field_id, &v, sizeof(v));
    }
    case ID_accel_NVS: {
        int v = static_cast<int>(config_.accel_threshold);
        return nvs_.write(field_id, &v, sizeof(v));
    }
    case ID_turnedOn_NVS: {
        int v = config_.turned_on ? 1 : 0;
        return nvs_.write(field_id, &v, sizeof(v));
    }
    default:
        return -1;
    }
}

const BeaconConfig& SettingsManager::config() const {
    return config_;
}

// ---- Validated setters ----

bool SettingsManager::set_mult_period(uint8_t v) {
    if (v != 1 && v != 2 && v != 4 && v != 8)
        return false;
    config_.mult_period = v;
    return true;
}

bool SettingsManager::set_tx_power(uint8_t v) {
    if (v > 2)
        return false;
    config_.tx_power = v;
    return true;
}

bool SettingsManager::set_change_interval(uint16_t v) {
    if (v < 30 || v > 7200)
        return false;
    config_.change_interval = v - (v % 8); // Align to multiple of 8
    return true;
}

bool SettingsManager::set_status_flags(uint32_t v) {
    config_.status_flags = v;
    return true;
}

bool SettingsManager::set_accel_threshold(uint16_t v) {
    if (v > 16383)
        return false;
    config_.accel_threshold = v;
    return true;
}

void SettingsManager::set_flag_fmdn(bool v) {
    config_.flag_fmdn = v;
}

void SettingsManager::set_flag_airtag(bool v) {
    config_.flag_airtag = v;
}

void SettingsManager::set_turned_on(bool v) {
    config_.turned_on = v;
}

void SettingsManager::set_fmdn_key(const uint8_t* data, size_t len) {
    if (len == config_.fmdn_key.size()) {
        std::memcpy(config_.fmdn_key.data(), data, len);
    }
}

void SettingsManager::set_settings_mac(const uint8_t* data, size_t len) {
    if (len == config_.settings_mac.size()) {
        std::memcpy(config_.settings_mac.data(), data, len);
    }
}

void SettingsManager::set_auth_code(const uint8_t* data, size_t len) {
    if (len == config_.auth_code.size()) {
        std::memcpy(config_.auth_code.data(), data, len);
    }
}

void SettingsManager::set_key_chunk(int key_idx, size_t offset, const uint8_t* data, size_t len) {
    if (key_idx < 0 || key_idx >= kMaxKeysInMemory || len != 14 || (offset != 0 && offset != 14) ||
        offset + len > kKeySize) {
        return;
    }
    std::memcpy(config_.keys[static_cast<size_t>(key_idx)].data() + offset, data, len);
}

void SettingsManager::set_num_keys(uint8_t n) {
    if (n <= kMaxKeysInMemory) {
        config_.num_keys = n;
    }
}

int64_t SettingsManager::get_time(uint32_t uptime_sec) const {
    return config_.time_offset + static_cast<int64_t>(uptime_sec);
}

void SettingsManager::update_time_offset(int64_t new_time, uint32_t uptime_sec) {
    config_.time_offset = new_time - static_cast<int64_t>(uptime_sec);
}

void SettingsManager::save_time(uint32_t uptime_sec) {
    int64_t current = get_time(uptime_sec);
    nvs_.write(ID_timeOffset_NVS, &current, sizeof(current));
}

// ---- GATT validators ----

GattResult validate_field(const uint8_t* buf, size_t len, bool authorized,
                          const GattFieldSpec& spec, int32_t& out) {
    if (len != spec.expected_len) {
        return GattResult::InvalidLength;
    }
    if (!authorized) {
        return GattResult::Unauthorized;
    }

    int32_t value = 0;
    std::memcpy(&value, buf, sizeof(value));

    if (spec.allowed_values != nullptr) {
        bool found = false;
        for (size_t i = 0; i < spec.allowed_count; i++) {
            if (value == spec.allowed_values[i]) {
                found = true;
                break;
            }
        }
        if (!found) {
            return GattResult::OutOfRange;
        }
    } else {
        if (value < spec.min_val || value > spec.max_val) {
            return GattResult::OutOfRange;
        }
    }

    out = value;
    return GattResult::Ok;
}

GattResult validate_auth_code(const uint8_t* buf, size_t len, const uint8_t* stored,
                              size_t code_len) {
    if (len != code_len) {
        return GattResult::InvalidLength;
    }

    // Constant-time comparison
    uint8_t diff = 0;
    for (size_t i = 0; i < code_len; i++) {
        diff |= static_cast<uint8_t>(buf[i] ^ stored[i]);
    }

    return (diff == 0) ? GattResult::Ok : GattResult::Unauthorized;
}

GattResult validate_key_chunk(const uint8_t* /*buf*/, size_t len, bool authorized,
                              int keys_received, int max_keys) {
    if (len != 14) {
        return GattResult::InvalidLength;
    }
    if (!authorized) {
        return GattResult::Unauthorized;
    }
    if (keys_received >= 2 * max_keys) {
        return GattResult::OutOfRange;
    }
    return GattResult::Ok;
}

} // namespace beacon
```

## src/beacon_config.hpp
```c
// beacon_config.hpp — Settings, NVS persistence, GATT validation
#ifndef BEACON_CONFIG_HPP
#define BEACON_CONFIG_HPP

#include <array>
#include <cstddef>
#include <cstdint>
#include <cstring>

namespace beacon {

// ---- NVS field IDs (match settings.c) ----
enum NvsFieldId : uint16_t {
    ID_fmdn_NVS = 0x01,
    ID_airtag_NVS = 0x02,
    ID_period_NVS = 0x03,
    ID_changeInterval_NVS = 0x04,
    ID_key_NVS = 0x05,
    ID_auth_NVS = 0x06,
    ID_power_NVS = 0x07,
    ID_fmdnKey_NVS = 0x08,
    ID_timeOffset_NVS = 0x09,
    ID_settingsMAC_NVS = 0x0a,
    ID_status_NVS = 0x0b,
    ID_accel_NVS = 0x0c,
    ID_turnedOn_NVS = 0x0d,
};

// ---- Constants ----
inline constexpr int kMaxKeysInMemory = 40;
inline constexpr int kKeySize = 28;

// ---- Status types ----

/// Status mode for AirTag/FMDN status byte generation.
enum class StatusMode : uint8_t {
    Off = 0,          // Don't touch status byte
    Fixed = 1,        // Broadcast base byte as-is
    Incrementing = 2, // Broadcast keys_changes counter
    Voltage = 3,      // Broadcast battery voltage (mV / 100)
    BatteryLevel = 4, // Broadcast battery level (0..3) OR'd into base byte
    Telemetry = 5,    // Cycle between voltage, accel, temperature each minute
};

/// Decoded view of the packed status_flags field.
struct StatusFlags {
    uint8_t airtag_base = 0x00;
    uint8_t fmdn_base = 0x80;
    StatusMode airtag_mode = StatusMode::Telemetry;
    StatusMode fmdn_mode = StatusMode::BatteryLevel;

    uint32_t pack() const;
    static StatusFlags unpack(uint32_t raw);
};

// ---- BeaconConfig (consolidates all globals from settings.c) ----
//
// All fields are persisted in NVS as 4-byte ints (wire format).
// On load, values are validated against allowed ranges; out-of-range
// values fall back to the defaults shown here.
struct BeaconConfig {
    bool flag_fmdn = false;           // Enable Google Find My Device Network broadcasting
    bool flag_airtag = false;         // Enable Apple AirTag (Offline Finding) broadcasting
    uint8_t mult_period = 2;          // Advertising interval multiplier {1,2,4,8}
    uint8_t tx_power = 2;             // TX power index: 0 = -8 dBm, 1 = 0 dBm, 2 = +4 dBm
    uint16_t change_interval = 6000;  // Key rotation interval in seconds [30..7200], aligned to 8
    uint32_t status_flags = 0x458000; // Packed status byte config (see status_flags encoding below)
    uint16_t accel_threshold = 800;   // Accelerometer movement threshold in mg [0..16383]
    bool turned_on = false;           // Master broadcast enable (persisted across reboots)
    int64_t time_offset = 0;          // Unix time offset: real_time = time_offset + uptime_seconds
    std::array<uint8_t, 8> auth_code = {'a', 'b', 'c', 'd', 'e', 'f', 'g', 'h'}; // GATT auth code
    // MAC address for settings mode. If first and last bytes are zero,
    // use the chip's factory MAC from UICR instead.
    std::array<uint8_t, 6> settings_mac = {0, 0x41, 0x42, 0x43, 0x44, 0};
    std::array<uint8_t, 20> fmdn_key = {}; // Google FMDN encryption key (single key, no rotation)
    std::array<std::array<uint8_t, 28>, 40> keys = {}; // AirTag public key ring
    uint8_t num_keys = 0;                              // Number of valid keys in keys[] [0..40]
};

// ---- status_flags encoding (from main.c) ----
//
// Packed 32-bit field controlling what goes in the AirTag/FMDN status bytes:
//   bits  0..7  — base status byte for AirTag (broadcast as-is in mode 1)
//   bits  8..15 — base status byte for FMDN  (broadcast as-is in mode 1)
//   bits 16..19 — AirTag status mode:
//     0 = off (don't touch status byte)
//     1 = broadcast base byte as-is
//     2 = broadcast incrementing byte (keys_changes counter)
//     3 = broadcast battery voltage (mV / 100)
//     4 = broadcast battery level (0..3) OR'd into base byte bits 6..7
//     5 = telemetry: cycle each minute between voltage, accel byte, temperature
//   bits 20..23 — FMDN status mode (same encoding as AirTag)
//
// Default 0x458000 = AirTag mode 5 (telemetry), FMDN mode 4 (battery level),
//                    AirTag base 0x00, FMDN base 0x80

// ---- INvsStorage interface (for testing) ----
class INvsStorage {
  public:
    virtual int read(uint16_t id, void* data, size_t len) = 0;
    virtual int write(uint16_t id, const void* data, size_t len) = 0;

  protected:
    ~INvsStorage() = default;
};

// ---- SettingsManager ----
class SettingsManager {
  public:
    explicit SettingsManager(INvsStorage& nvs);

    int load();
    int save_field(uint16_t field_id);

    const BeaconConfig& config() const;

    // Validated setters — return false if value rejected, leaving config unchanged.
    bool set_mult_period(uint8_t v);      // Allowed: {1, 2, 4, 8}
    bool set_tx_power(uint8_t v);         // Allowed: 0..2
    bool set_change_interval(uint16_t v); // Range: 30..7200, auto-aligned to multiple of 8
    void set_status_flags(uint32_t v);    // Any value accepted (app-level encoding)
    bool set_accel_threshold(uint16_t v); // Range: 0..16383
    void set_flag_fmdn(bool v);
    void set_flag_airtag(bool v);
    void set_turned_on(bool v);
    void set_fmdn_key(const uint8_t* data, size_t len);     // len must be 20
    void set_settings_mac(const uint8_t* data, size_t len); // len must be 6
    void set_auth_code(const uint8_t* data, size_t len);    // len must be 8
    // Write a 14-byte half of a key. key_idx in [0..39], offset 0 or 14.
    void set_key_chunk(int key_idx, size_t offset, const uint8_t* data, size_t len);
    void set_num_keys(uint8_t n); // [0..40]

    int64_t get_time(uint32_t uptime_sec) const;
    void update_time_offset(int64_t new_time, uint32_t uptime_sec);
    void save_time(uint32_t uptime_sec);

  private:
    INvsStorage& nvs_;
    BeaconConfig config_;

    // Helper: read a bool from NVS (stored as 4-byte int); on failure, leave dest unchanged
    void read_bool(uint16_t id, bool& dest);
};

// ---- GATT validation (pure functions, no Zephyr dependency) ----
struct GattFieldSpec {
    size_t expected_len;
    int32_t min_val;
    int32_t max_val;
    const int32_t* allowed_values; // null = any in range
    size_t allowed_count;
};

enum class GattResult : uint8_t {
    Ok,
    InvalidLength,
    Unauthorized,
    OutOfRange,
};

GattResult validate_field(const uint8_t* buf, size_t len, bool authorized,
                          const GattFieldSpec& spec, int32_t& out);

GattResult validate_auth_code(const uint8_t* buf, size_t len, const uint8_t* stored,
                              size_t code_len);

GattResult validate_key_chunk(const uint8_t* buf, size_t len, bool authorized, int keys_received,
                              int max_keys);

} // namespace beacon

#endif // BEACON_CONFIG_HPP
```

## src/beacon_logic.cpp
```c
// beacon_logic.cpp — Pure computation functions for BLE advertisement
#include "beacon_logic.hpp"

#include <cstring>

namespace beacon {

void derive_mac_from_key(const uint8_t* key, uint8_t* mac_out) {
    mac_out[5] = key[0] | 0xC0;
    mac_out[4] = key[1];
    mac_out[3] = key[2];
    mac_out[2] = key[3];
    mac_out[1] = key[4];
    mac_out[0] = key[5];
}

void fill_adv_template(const uint8_t* key, uint8_t* tmpl, size_t tmpl_size) {
    if (tmpl_size < 30) {
        return;
    }
    std::memcpy(&tmpl[7], &key[6], 22);
    tmpl[29] = static_cast<uint8_t>(key[0] >> 6);
}

bool is_key_empty(const uint8_t* key, size_t len) {
    for (size_t i = 0; i < len; i++) {
        if (key[i] != 0) {
            return false;
        }
    }
    return true;
}

// Compute status byte for one protocol (AirTag or FMDN).
// base_status is the default byte from StatusFlags, mode selects the computation.
// battery_shift is 6 for AirTag (bits 6..7), 5 for FMDN (bits 5..6).
static uint8_t compute_one_status(uint8_t base_status, StatusMode mode, const StatusInput& in,
                                  int battery_shift, int battery_default) {
    switch (mode) {
    case StatusMode::Fixed:
        return base_status;
    case StatusMode::Incrementing:
        return static_cast<uint8_t>(in.keys_changes & 0xFF);
    case StatusMode::Voltage:
    case StatusMode::Telemetry:
        // Start with battery voltage
        base_status = static_cast<uint8_t>(in.battery_voltage / 100);
        if (mode == StatusMode::Voltage || in.what_in_status == 0) {
            return base_status;
        }
        if (in.what_in_status == 1) {
            return static_cast<uint8_t>(0x80 | in.accel_byte);
        }
        if (in.what_in_status == 2) {
            // Temperature in -10..53C range as positive 6-bit integer
            int tmp_temp = (in.temperature + 5) / 10 + 10;
            if (tmp_temp < 0) {
                tmp_temp = 0;
            }
            if (tmp_temp > 63) {
                tmp_temp = 63;
            }
            return static_cast<uint8_t>(0x40 | tmp_temp);
        }
        return base_status;
    case StatusMode::BatteryLevel: {
        int battery = battery_default;
        if (battery_shift == 6) {
            // AirTag: 4-level (0=full, 1=normal, 2=low, 3=critical)
            if (in.battery_voltage > kBatteryLevelFull) {
                battery = 0;
            } else if (in.battery_voltage > kBatteryLevelNormal) {
                battery = 1;
            } else if (in.battery_voltage > kBatteryLevelLow) {
                battery = 2;
            } else {
                battery = 3;
            }
        } else {
            // FMDN: 3-level (0=unknown, 1=normal, 2=low, 3=critical)
            if (in.battery_voltage > kBatteryLevelNormal) {
                battery = 1;
            } else if (in.battery_voltage > kBatteryLevelLow) {
                battery = 2;
            } else if (in.battery_voltage > 0) {
                battery = 3;
            } else {
                battery = 0;
            }
        }
        return static_cast<uint8_t>(base_status | (battery << battery_shift));
    }
    case StatusMode::Off:
    default:
        return base_status;
    }
}

StatusOutput compute_status(const StatusInput& in) {
    StatusOutput out{};
    out.airtag_status = compute_one_status(in.status.airtag_base, in.status.airtag_mode, in, 6, 3);
    out.fmdn_status = compute_one_status(in.status.fmdn_base, in.status.fmdn_mode, in, 5, 0);
    return out;
}

} // namespace beacon
```

## src/beacon_logic.hpp
```c
// beacon_logic.hpp — Pure computation functions for BLE advertisement
#ifndef BEACON_LOGIC_HPP
#define BEACON_LOGIC_HPP

#include <cstddef>
#include <cstdint>

#include "beacon_config.hpp" // StatusFlags, StatusMode

namespace beacon {

/// Derive a BLE MAC address from a 28-byte public key.
/// Copies first 6 bytes of key into mac_out in reverse order,
/// OR's the last byte (mac_out[5]) with 0xC0.
void derive_mac_from_key(const uint8_t* key, uint8_t* mac_out);

/// Fill an AirTag advertisement template from a 28-byte public key.
/// Copies key[6..27] into tmpl[7..28], sets tmpl[29] = key[0] >> 6.
/// tmpl must be at least 30 bytes; tmpl_size is for safety checks.
void fill_adv_template(const uint8_t* key, uint8_t* tmpl, size_t tmpl_size);

/// Returns true if all bytes in key[0..len-1] are zero.
bool is_key_empty(const uint8_t* key, size_t len);

/// Input to the status computation (replaces all globals).
struct StatusInput {
    StatusFlags status;           // Decoded status configuration
    uint16_t battery_voltage = 0; // Battery voltage in millivolts (e.g. 3800 = 3.8V)
    uint16_t keys_changes = 0;    // Rolling counter of AirTag key rotations (used by mode 2)
    uint8_t what_in_status = 0;   // Telemetry cycle selector: 0=voltage, 1=accel, 2=temperature
    uint8_t accel_byte = 0;  // 7-bit movement summary from MovementTracker::compute_accel_byte()
    int16_t temperature = 0; // Accelerometer die temperature in 0.1C units (e.g. 235 = 23.5C)
};

/// Output of the status computation.
struct StatusOutput {
    uint8_t airtag_status;
    uint8_t fmdn_status;
};

// Battery level thresholds (defaults for Li-Ion, matching myboards.h)
constexpr int kBatteryLevelFull = 4000;
constexpr int kBatteryLevelNormal = 3700;
constexpr int kBatteryLevelLow = 3300;

/// Compute the AirTag and FMDN status bytes.
/// Pure function — all state is passed explicitly via StatusInput.
StatusOutput compute_status(const StatusInput& in);

} // namespace beacon

#endif // BEACON_LOGIC_HPP
```

## src/ble_glue.h
```c
// ble_glue.h -- BLE advertisement data arrays shared between C and C++
#ifndef BLE_GLUE_H
#define BLE_GLUE_H

#include <zephyr/bluetooth/bluetooth.h>

#ifdef __cplusplus
extern "C" {
#endif

// Advertisement data arrays (defined in ble_glue.c)
extern struct bt_data adv_airtag[];
extern struct bt_data adv_fmdn[];
extern struct bt_data adv_ibeacon[];

// Sizes for data arrays
#define OFFLINE_FINDING_ADV_TEMPLATE_SIZE 31
#define ADV_AIRTAG_COUNT 1
#define ADV_FMDN_COUNT 2
#define ADV_IBEACON_COUNT 2

// Raw data stores (writable from C++)
extern uint8_t airtag_data_store[OFFLINE_FINDING_ADV_TEMPLATE_SIZE];
extern uint8_t fmdn_data_store[25];
extern uint8_t iBeacon_data[32];
extern uint8_t bleAddr[6];

// AirTag advertisement template
extern uint8_t offline_finding_adv_template[OFFLINE_FINDING_ADV_TEMPLATE_SIZE];

#ifdef __cplusplus
}
#endif

#endif // BLE_GLUE_H
```
